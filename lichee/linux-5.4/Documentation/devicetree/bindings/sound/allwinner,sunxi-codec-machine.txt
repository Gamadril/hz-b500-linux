## lichee/linux-5.4/Documentation/devicetree/bindings/sound/allwinner,sunxi-codec-machine.txt
```
Allwinner BSP internal codec machine driver (sun20iw1)

Required properties:
- compatible: "allwinner,sunxi-codec-machine"
- sunxi,audio-codec: phandle to the internal codec
- sunxi,cpudai-controller: phandle to the codec CPU DAI

Optional board routing properties:
- jack_enable: <0> disables headset jack detection; <1> enables it.
- allwinner,fixed-headphone-output: boolean. The board permanently connects
  both HPOUTL and HPOUTR to a downstream analog device. Enable these pins and
  the Headphone DAPM endpoint when the card is initialized, without creating
  a headset jack. Set jack_enable = <0> when using this property. The DAC and
  headphone amplifier still follow normal PCM/DAPM power management. This
  property does not control the downstream device or enable a speaker GPIO.

Example:
  &sndcodec {
      jack_enable = <0>;
      allwinner,fixed-headphone-output;
      status = "okay";
  };
```

## package/allwinner/swupdate/config/bootloader/Config.in
```kconfig
choice
	prompt "Bootloader interface"
	default SWUPDATE_CONFIG_BOOTLOADER_NONE
	help
	  Choose the bootloader

config SWUPDATE_CONFIG_BOOTLOADER_EBG
	bool "EFI Boot Guard"
	depends on SWUPDATE_CONFIG_HAVE_LIBEBGENV
	depends on SWUPDATE_CONFIG_HAVE_ZLIB
	help
	  Support for EFI Boot Guard
	  https://github.com/siemens/efibootguard

comment "EFI Boot Guard needs libebgenv and libz"
	depends on !SWUPDATE_CONFIG_HAVE_ZLIB || !SWUPDATE_CONFIG_HAVE_LIBEBGENV

config SWUPDATE_CONFIG_BOOTLOADER_NONE
	bool "Environment in RAM"
	help
	  This simulates the interface to a bootloader.
	  Bootloader environment is just maitained in RAM
	  and lost when SWUpdate exits.

config SWUPDATE_CONFIG_BOOTLOADER_GRUB
	bool "GRUB"
	help
	  Support for GRUB
	  https://www.gnu.org/software/grub/
endchoice

config SWUPDATE_CONFIG_GRUBENV_PATH
	string "GRUB Environment block file path"
	depends on SWUPDATE_CONFIG_BOOTLOADER_GRUB
	default SWUPDATE_DEFAULT_GRUBENV_PATH
	help
	  Provide path to GRUB environment block file
```
